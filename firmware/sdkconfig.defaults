## firmware/sdkconfig.defaults
```kconfig
# ---- Flash / CPU ----
CONFIG_ESPTOOLPY_FLASHSIZE_8MB=y
CONFIG_ESPTOOLPY_FLASHMODE_QIO=y
CONFIG_ESP_DEFAULT_CPU_FREQ_MHZ_240=y

# ---- 分区表（自定义，为 Clawd 素材留足 app 空间）----
CONFIG_PARTITION_TABLE_CUSTOM=y
CONFIG_PARTITION_TABLE_CUSTOM_FILENAME="partitions.csv"
CONFIG_PARTITION_TABLE_OFFSET=0x8000

# ---- PSRAM（Octal，AMOLED 帧缓冲 / 图片解码用）----
CONFIG_SPIRAM=y
CONFIG_SPIRAM_MODE_OCT=y
CONFIG_SPIRAM_SPEED_80M=y
CONFIG_SPIRAM_MALLOC_ALWAYSINTERNAL=2048
CONFIG_SPIRAM_MALLOC_RESERVE_INTERNAL=98304

# ---- 主任务栈 ----
CONFIG_ESP_MAIN_TASK_STACK_SIZE=8192

# ---- 编译优化：优先体积 ----
CONFIG_COMPILER_OPTIMIZATION_SIZE=y

# ---- BLE（NimBLE host，NUS + WiFi 配网 GATT server）----
CONFIG_BT_ENABLED=y
CONFIG_BT_BLUEDROID_ENABLED=n
CONFIG_BT_NIMBLE_ENABLED=y
CONFIG_BT_NIMBLE_ATT_PREFERRED_MTU=247
CONFIG_BT_NIMBLE_SVC_GAP_DEVICE_NAME="ClawdPet"
# 只用 BLE（ESP32-S3 无经典蓝牙），省电省内存
CONFIG_BTDM_CTRL_MODE_BLE_ONLY=y
CONFIG_BTDM_CTRL_MODE_BR_EDR_ONLY=n
CONFIG_BTDM_CTRL_MODE_BTDM=n

# ---- WiFi STA（BLE 配网连通验证）----
CONFIG_ESP_WIFI_ENABLED=y
CONFIG_ESP_WIFI_STATIC_RX_BUFFER_NUM=10
CONFIG_ESP_WIFI_DYNAMIC_RX_BUFFER_NUM=32

# ---- LVGL 9 ----
# 显示刷新 16ms≈62.5fps，触摸快滑由 app_main 直读触控 IC 独立采样（10ms）。
# 显示刷新周期由 bsp_set_refr_period() 动态设置（lv_timer_set_period），不再设固定默认值。
CONFIG_LV_OS_FREERTOS=y
CONFIG_LV_USE_CLIB_MALLOC=y
CONFIG_LV_USE_CLIB_STRING=y
CONFIG_LV_USE_CLIB_SPRINTF=y
CONFIG_LV_FONT_MONTSERRAT_12=y
CONFIG_LV_FONT_MONTSERRAT_14=y
CONFIG_LV_FONT_MONTSERRAT_16=y
CONFIG_LV_FONT_MONTSERRAT_24=y
CONFIG_LV_FONT_MONTSERRAT_28=y
CONFIG_LV_FONT_MONTSERRAT_32=y
CONFIG_LV_FONT_MONTSERRAT_48=y
CONFIG_LV_FONT_FMT_TXT_LARGE=y
CONFIG_LV_USE_FONT_PLACEHOLDER=y

# GIF decoder（lv_gif widget）
CONFIG_LV_USE_GIF=y
CONFIG_LV_GIF_CACHE_DECODE_DATA=y

# FreeType — emoji fallback font
CONFIG_LV_USE_FREETYPE=y
CONFIG_LV_FREETYPE_CACHE_SIZE=64
CONFIG_LV_DRAW_THREAD_STACK_SIZE=32768
CONFIG_LV_USE_VG_LITE=n
CONFIG_LV_USE_VG_LITE_TTF=n
CONFIG_LV_USE_THORVG=n

# 关掉本 demo 用不到的控件，省 Flash
CONFIG_LV_USE_CALENDAR=n
CONFIG_LV_USE_CHART=n
CONFIG_LV_USE_KEYBOARD=n
CONFIG_LV_USE_TABVIEW=n
CONFIG_LV_USE_TILEVIEW=n
CONFIG_LV_USE_WIN=n
CONFIG_LV_BUILD_EXAMPLES=n
CONFIG_LV_BUILD_DEMOS=n
```
